## configs/defconfig
```kconfig
#
# Olimex iCE40HX8K-EVB RISC-V Default Configuration
# This configuration replicates the current working system exactly
#

#
# Toolchain Options
#
CONFIG_TOOLCHAIN_SYSTEM=y
CONFIG_FPGA_TOOLS_SYSTEM=y

#
# PicoRV32 Core Configuration
#
CONFIG_PICORV32_REPO="https://github.com/YosysHQ/picorv32.git"
CONFIG_PICORV32_COMMIT="main"

# ISA Configuration (RV32IM - no compressed)
CONFIG_ENABLE_MUL=y
CONFIG_ENABLE_DIV=y
CONFIG_BARREL_SHIFTER=y

# Core Parameters
CONFIG_PROGADDR_RESET=0x00040000
CONFIG_PROGADDR_IRQ=0x00000010
CONFIG_STACKADDR=0x00080000

#
# Memory Configuration
#
CONFIG_ROM_BASE=0x00040000
CONFIG_ROM_SIZE=0x00002000
CONFIG_APP_SRAM_BASE=0x00000000
CONFIG_APP_SRAM_SIZE=0x00040000
CONFIG_STACK_SRAM_BASE=0x00042000
CONFIG_STACK_SRAM_SIZE=0x0003E000
CONFIG_STACK_SIZE=0x00004000

#
# Peripheral Configuration
#
CONFIG_MMIO_BASE=0x80000000
CONFIG_PERIPHERAL_UART=y
CONFIG_UART_BASE=0x80000000
CONFIG_UART_BAUDRATE=115200
CONFIG_PERIPHERAL_TIMER=y
CONFIG_TIMER_BASE=0x80000020
CONFIG_PERIPHERAL_GPIO=y

#
# Build Options
#
CONFIG_BOARD="olimex-ice40hx8k"
CONFIG_PCF_FILE="hdl/ice40_picorv32.pcf"
CONFIG_OPT_TIMING=y
CONFIG_SYNTH_ABC9=y
CONFIG_ENABLE_SIMULATION=y
CONFIG_BUILD_NEWLIB=y
CONFIG_NEWLIB_NANO=y
CONFIG_NEWLIB_IO_FLOAT=y
```
